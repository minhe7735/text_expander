## Kconfig
```kconfig
config ZMK_TEXT_EXPANDER
    bool "Enable text expander behavior"
    default n
    help
      Enable text expansion functionality that allows short codes
      to be expanded into longer text strings.

if ZMK_TEXT_EXPANDER

config ZMK_TEXT_EXPANDER_AGGRESSIVE_RESET_MODE
    bool "Enable aggressive reset mode for text expander"
    default n
    help
      If enabled, the currently typed short code will be reset
      if it does not form a valid prefix of any defined short code
      in the trie. The default behavior (when this is disabled)
      allows typing sequences that are not prefixes and only resets
      on specific keys like space or other non-alphanumeric/non-modifier keys.

config ZMK_TEXT_EXPANDER_RESET_ON_ENTER
    bool "Reset current short code on Enter key press"
    default n
    help
      If enabled, pressing the Enter key will reset the current
      text expander short code buffer if it does not trigger an expansion
      and aggressive reset mode (if active) hasn't already reset it.
      By default, Enter does not reset the buffer.

config ZMK_TEXT_EXPANDER_RESET_ON_TAB
    bool "Reset current short code on Tab key press"
    default n
    help
      If enabled, pressing the Tab key will reset the current
      text expander short code buffer if it does not trigger an expansion
      and aggressive reset mode (if active) hasn't already reset it.
      By default, Tab does not reset the buffer.

config ZMK_TEXT_EXPANDER_MAX_EXPANSIONS
    int "Maximum number of expansion pairs"
    default 32
    range 1 128
    help
      Maximum number of short/expanded text pairs that can be stored.

config ZMK_TEXT_EXPANDER_MAX_SHORT_LEN
    int "Maximum short code length"
    default 16
    range 4 32
    help
      Maximum length for short codes.

config ZMK_TEXT_EXPANDER_MAX_EXPANDED_LEN
    int "Maximum expanded text length"
    default 128
    range 16 512
    help
      Maximum length for expanded text.

config ZMK_TEXT_EXPANDER_TYPING_DELAY
    int "Delay between keystrokes in milliseconds"
    default 10
    range 1 100
    help
      Delay between individual keystrokes when typing expanded text.

endif # ZMK_TEXT_EXPANDER
```

## dts/bindings/behaviors/zmk,behavior-text-expander.yaml
```yaml
description: Text expander behavior for ZMK
compatible: "zmk,behavior-text-expander"
include: zero_param.yaml

child-binding:
  description: |
    Text expansion definition. Each child node defines a short code and
    its corresponding expanded text.
    
  properties:
    short_code:
      type: string
      required: true
      description: |
        The short code that will trigger the expansion. Must contain only
        lowercase letters (a-z) and numbers (0-9).
        
    expanded_text:
      type: string  
      required: true
      description: |
        The text that the short code will expand to.
```
